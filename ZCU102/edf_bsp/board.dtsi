// SPDX-License-Identifier: BSD-3-Clause
// PYNQ CMA policy, following the upstream RFSoC-PYNQ low-memory pool layout.
/ {
    reserved-memory {
        #address-cells = <2>;
        #size-cells = <2>;
        ranges;
        linux,cma {
            compatible = "shared-dma-pool";
            reusable;
            size = <0x0 0x20000000>;
            alignment = <0x0 0x2000>;
            alloc-ranges = <0x0 0x0 0x0 0x80000000>;
            linux,cma-default;
        };
    };
};
